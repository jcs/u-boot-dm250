## arch/arm/mach-rockchip/rk3128/Kconfig
```kconfig
if ROCKCHIP_RK3128

choice
	prompt "RK3128 board select"

config TARGET_EVB_RK3128
	bool "RK3128 evaluation board"
	select BOARD_LATE_INIT
	help
	  RK3128evb is a evaluation board for Rockchip rk3128,
	  with full function and phisical connectors support like
	  usb2.0 host ports, LVDS, JTAG, MAC, SDcard, HDMI, USB-2-serial...

config TARGET_KINGJIM_DM250
	bool "KING JIM Pomera DM250"
	select BOARD_LATE_INIT
	help
          KING JIM Pomera DM250 digital typewriter

endchoice

config SYS_SOC
	default "rockchip"

config SYS_MALLOC_F_LEN
	default 0x0800

source "board/rockchip/evb_rk3128/Kconfig"
source "board/kingjim/dm250/Kconfig"

endif
```

## board/kingjim/dm250/Kconfig
```kconfig
if TARGET_KINGJIM_DM250

config SYS_BOARD
	default "dm250"

config SYS_VENDOR
	default "kingjim"

config SYS_CONFIG_NAME
	default "kingjim_dm250"

config BOARD_SPECIFIC_OPTIONS # dummy
	def_bool y

endif
```
